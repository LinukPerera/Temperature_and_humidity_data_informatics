#include "WiFi.h"
#include <HTTPClient.h>
#include "DHT.h"
#include <Adafruit_GFX.h>
#include <Adafruit_SSD1306.h>

// Defining LED PINs on the ESP32 Board.
#define On_Board_LED_PIN  2

// Defines the DHT22 PIN and DHT sensor type.
#define DHTPIN  5
#define DHTTYPE DHT22

// OLED display parameters
#define SCREEN_WIDTH 128 // OLED display width, in pixels
#define SCREEN_HEIGHT 64 // OLED display height, in pixels
#define OLED_RESET     -1 // Reset pin # (or -1 if sharing Arduino reset pin)
Adafruit_SSD1306 display(SCREEN_WIDTH, SCREEN_HEIGHT, &Wire, OLED_RESET);

// WiFi credentials
const char* ssid = "DB03IDialog1-24BA";  //--> Your wifi name
const char* password = "32071749"; //--> Your wifi password
const char* Room_No = "Store 2";

int Check = 1;
int logo = 1;

const unsigned char myBitmap[] PROGMEM = {
	0xff, 0xff, 0xff, 0xff, 0xff, 0xff, 0xff, 0xff, 0xff, 0xff, 0xff, 0xff, 0xff, 0xff, 0xff, 0xff, 
	0xff, 0xff, 0xff, 0xff, 0xff, 0xff, 0xff, 0xff, 0xff, 0xff, 0xff, 0xff, 0xff, 0xff, 0xff, 0xff, 
	0xff, 0xff, 0xff, 0xff, 0xff, 0xff, 0xff, 0xff, 0xff, 0xff, 0xff, 0xff, 0xff, 0xff, 0xff, 0xff, 
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	0xff, 0xff, 0xff, 0xff, 0xff, 0xff, 0xff, 0xff, 0xff, 0xff, 0xff, 0xff, 0xff, 0xff, 0xff, 0xff
};

// Google Sheets script URL
String Web_App_URL = "https://script.google.com/macros/s/AKfycbwCvf5gUXhVz8xE-kkOVkyb6XBuO2Pt0bVk_uJGl78rnIU2OG5FSG57p1vT-6oMBMHEOQ/exec";
//"https://script.google.com/macros/s/AKfycbyB4HMbIVOidgWYHE0Wo1qe3x7-KamI6EMPdX8U_6skZoLohYrui-kEfwXMvzSwWvsXYQ/exec";
//https://script.google.com/macros/s/AKfycbwCvf5gUXhVz8xE-kkOVkyb6XBuO2Pt0bVk_uJGl78rnIU2OG5FSG57p1vT-6oMBMHEOQ/exec

String Status_Read_Sensor = "";
String Network_Status = "Connecting..."; // Default status
float Temp;
int Humd;

int ttl = 0;

// Initialize DHT as dht22
DHT dht22(DHTPIN, DHTTYPE);

// Function to center-align text on the OLED display
void displayCenteredText(const char* text, int y) {
  int16_t x1, y1;
  uint16_t width, height;
  display.getTextBounds(text, 0, y, &x1, &y1, &width, &height);
  int16_t x = (SCREEN_WIDTH - width) / 2;
  display.setCursor(x, y);
  display.print(text);
}

// Subroutine for getting temperature and humidity data from the DHT22 sensor
void Getting_DHT22_Sensor_Data() {
  Humd = dht22.readHumidity();
  Temp = dht22.readTemperature();

  if (isnan(Humd) || isnan(Temp)) {
    Serial.println(F("Failed to read from DHT sensor!"));
    Status_Read_Sensor = "Failed";
    Temp = 0.00;
    Humd = 0;
  } else {
    Status_Read_Sensor = "Success";
  }
}

// Function to update the OLED display
void updateDisplay() {
  // Update OLED display
  if(logo = 1){
    display.clearDisplay();
    display.drawBitmap(0, 0, myBitmap, SCREEN_WIDTH, SCREEN_HEIGHT, WHITE);
    delay(2000);
    logo = 0;
  }
    
  display.clearDisplay();
  // Display temperature and humidity centered
  display.setTextSize(2);
  display.setTextColor(SSD1306_WHITE);
  char tempStr[10];
  snprintf(tempStr, sizeof(tempStr), "Temp:%.2fC", Temp);
  displayCenteredText(tempStr, 0);

  char humdStr[16];
  snprintf(humdStr, sizeof(humdStr), "Hum:%d%%", Humd);
  displayCenteredText(humdStr, 20);

  // Display network status centered on the third line
  display.setTextSize(1);
  char statusStr[32];
  snprintf(statusStr, sizeof(statusStr), "Status: %s", Network_Status.c_str());
  displayCenteredText(statusStr, 45);

  display.display();
}

// Function to connect to WiFi
void connectToWiFi() {
  Serial.print("Connecting to ");
  Serial.println(ssid);
  WiFi.begin(ssid, password);

  int connecting_process_timed_out = 20; //--> 20 = 20 seconds.
  connecting_process_timed_out = connecting_process_timed_out * 2;
  while (WiFi.status() != WL_CONNECTED) {
    Serial.print(".");
    digitalWrite(On_Board_LED_PIN, HIGH);
    delay(250);
    digitalWrite(On_Board_LED_PIN, LOW);
    delay(250);

    // Update display while trying to connect
    Network_Status = "Connecting...";
    updateDisplay();

    if (connecting_process_timed_out > 0) connecting_process_timed_out--;
    if (connecting_process_timed_out == 0) {
      delay(1000);
      ssid = "SIJ";  //--> Your wifi name
      password = "yenuk1234"; //--> Your wifi password
      Check = Check + 1;
      WiFi.begin(ssid, password);
      connecting_process_timed_out = 40; // Reset the timeout for the new credentials
    }
    if (Check > 20) {
      Network_Status = "Network Failed"; // Update network status
      Serial.println("Network connection failed.");
      return; // Exit the function if unable to connect
    }
  }
  
  Network_Status = "Connected"; // Update network status
  Serial.println();
  Serial.println("WiFi connected");
  Serial.println("------------");
}

void setup() {
  Serial.begin(115200);
  Serial.println();
  delay(1000);

  pinMode(On_Board_LED_PIN, OUTPUT);

  Serial.println("-------------");
  Serial.println("WIFI mode : STA");
  WiFi.mode(WIFI_STA);
  Serial.println("-------------");

  // Start DHT22
  Serial.println();
  Serial.println("DHT22 Begin");
  Serial.println();
  dht22.begin();
  delay(2000);

  // Initialize OLED display with I2C address 0x3C
  if (!display.begin(SSD1306_SWITCHCAPVCC, 0x3C)) {
    Serial.println(F("SSD1306 allocation failed"));
    for (;;); // Don't proceed, loop forever
  }
  display.display();
  delay(2000); // Pause for 2 seconds
  display.clearDisplay();
  display.display();

  // Connect to WiFi
  connectToWiFi();
}

void loop() {
  // Getting DHT22 sensor data
  Getting_DHT22_Sensor_Data();

  // Update the display with the latest readings and status
  updateDisplay();

  // Send data to Google Sheets if WiFi is connected
  if (WiFi.status() == WL_CONNECTED) {
    digitalWrite(On_Board_LED_PIN, HIGH);

    // Create a URL for sending data to Google Sheets
    String Send_Data_URL = Web_App_URL + "?sts=write";
    Send_Data_URL += "&srs=" + Status_Read_Sensor;
    Send_Data_URL += "&temp=" + String(Temp, 2);  // Ensure 2 decimal points
    Send_Data_URL += "&humd=" + String(Humd);
    Send_Data_URL += "&swtc1=" + String(Room_No);
    Send_Data_URL += "&swtc2=";

    // Replace spaces with %20 for URL encoding
    Send_Data_URL.replace(" ", "%20");

    // Print the URL to check its correctness
    Serial.println("-------------");
    Serial.println("Send data to Google Spreadsheet...");
    Serial.print("URL : ");
    Serial.println(Send_Data_URL);

    // Send data to Google Sheets
    HTTPClient http;
    http.begin(Send_Data_URL);
    http.setFollowRedirects(HTTPC_STRICT_FOLLOW_REDIRECTS);
    int httpCode = http.GET();
    Serial.print("HTTP Status Code : ");
    Serial.println(httpCode);

    if (httpCode > 0) {
      String payload = http.getString();
      Serial.println("Payload : " + payload);
    }

    http.end();

    digitalWrite(On_Board_LED_PIN, LOW);
    Serial.println("-------------");
  } else {
    Network_Status = "Network Failed"; // Update network status when not connected
  }

  delay(10000);
  if (ttl > 20) {
    ttl = 0;
    ESP.restart();
  } else {
    ttl = ttl + 1;
  }
  Serial.println(ttl);
}
